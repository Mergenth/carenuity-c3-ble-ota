## firmware/main/Kconfig.projbuild
```kconfig
menu "Carenuity BLE-OTA loader"

    config LOADER_WINDOW_S
        int "Update window after a hard reset (seconds)"
        range 2 120
        default 8
        help
            After power-on or a press of the reset button the board is
            visible over Bluetooth LE for this many seconds. If no phone
            connects, the installed sketch is started.

    config LOADER_BOOT_BUTTON_GPIO
        int "GPIO of the BOOT button (-1 to disable)"
        range -1 21
        default 9
        help
            Pressing this button (active low) while the update window is
            open keeps the board in update mode until the next reset.

    config LOADER_NAME_PREFIX
        string "Bluetooth name prefix"
        default "Carenuity-OTA"
        help
            The advertised name is "<prefix>-XXXX" where XXXX are the last
            two bytes of the Bluetooth address.

    config LOADER_EMULATOR_TEST
        bool "Emulator test build (no Bluetooth)"
        default n
        help
            Skips the Bluetooth start-up so that the reset policy of the
            bootloader and the update window can be tested in QEMU, which
            does not emulate the radio. Never enable this for a real board.

endmenu
```

## firmware/sdkconfig.defaults
```kconfig
# Target: ESP32-C3 with 4 MB flash (LOLIN / Wemos C3-Mini)
CONFIG_IDF_TARGET="esp32c3"
CONFIG_ESPTOOLPY_FLASHSIZE_4MB=y
CONFIG_ESPTOOLPY_FLASHMODE_DIO=y
CONFIG_ESPTOOLPY_FLASHFREQ_80M=y

CONFIG_PARTITION_TABLE_CUSTOM=y
CONFIG_PARTITION_TABLE_CUSTOM_FILENAME="partitions.csv"

# Console on the native USB port of the C3-Mini
CONFIG_ESP_CONSOLE_USB_SERIAL_JTAG=y

# Small binary
CONFIG_COMPILER_OPTIMIZATION_SIZE=y
CONFIG_BOOTLOADER_COMPILER_OPTIMIZATION_SIZE=y

# Bluetooth LE peripheral only (NimBLE)
CONFIG_BT_ENABLED=y
CONFIG_BT_NIMBLE_ENABLED=y
CONFIG_BT_NIMBLE_ROLE_CENTRAL=n
CONFIG_BT_NIMBLE_ROLE_OBSERVER=n
CONFIG_BT_NIMBLE_ROLE_PERIPHERAL=y
CONFIG_BT_NIMBLE_ROLE_BROADCASTER=y
CONFIG_BT_NIMBLE_MAX_CONNECTIONS=1
CONFIG_BT_NIMBLE_ATT_PREFERRED_MTU=517
CONFIG_BT_NIMBLE_SECURITY_ENABLE=n
CONFIG_BT_NIMBLE_NVS_PERSIST=n
CONFIG_BT_NIMBLE_MSYS_1_BLOCK_COUNT=40
CONFIG_BT_NIMBLE_SVC_GAP_DEVICE_NAME="Carenuity-OTA"
```
